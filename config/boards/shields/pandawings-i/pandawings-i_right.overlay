#include "pandawings-i.dtsi";

&default_transform {
  col-offset = <5>;
};

&kscan0 {
  col-gpios = <&xiao_d 7 GPIO_ACTIVE_HIGH>,  // col5 in schematic, col1 on pcb
              <&xiao_d 8 GPIO_ACTIVE_HIGH>,	 // col4 in schematic, col2 on pcb
              <&xiao_d 9 GPIO_ACTIVE_HIGH>,	 // col3 in schematic, col3 on pcb
              <&xiao_d 10 GPIO_ACTIVE_HIGH>, // col2 in schematic, col4 on pcb
              <&xiao_d 6 GPIO_ACTIVE_HIGH>;	 // col1 in schematic, col5 on pcb
};
