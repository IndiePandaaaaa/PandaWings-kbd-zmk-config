// thanks to: https://github.com/aroum/zmk-enki42-dongle
// and to: https://github.com/eigatech/zmk-config/tree/totem-dongle

#include "pandawings-i.dtsi"

&kscan0 {
  col-gpios
    = <&xiao_d 4 GPIO_ACTIVE_HIGH>
    , <&xiao_d 5 GPIO_ACTIVE_HIGH>
    , <&xiao_d 6 GPIO_ACTIVE_HIGH>
    , <&xiao_d 3 GPIO_ACTIVE_HIGH>
    , <&xiao_d 2 GPIO_ACTIVE_HIGH>
    , <&xiao_d 1 GPIO_ACTIVE_HIGH>
  ;
};
