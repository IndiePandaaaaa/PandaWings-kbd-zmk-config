#include "pandawings-i.dtsi";

&kscan0 {
  col-gpios = <&xiao_d 6 GPIO_ACTIVE_HIGH>,  // col1
              <&xiao_d 10 GPIO_ACTIVE_HIGH>, // col2
              <&xiao_d 9 GPIO_ACTIVE_HIGH>,  // col3
              <&xiao_d 8 GPIO_ACTIVE_HIGH>,  // col4
              <&xiao_d 7 GPIO_ACTIVE_HIGH>;  // col5
};
