## boards/shields/pandawings/Kconfig.defconfig
```kconfig
if PANDAWINGS_LEFT

  config ZMK_KEYBOARD_NAME
    default "PandaWings"

  config ZMK_SPLIT_ROLE_CENTRAL
    default y

endif

if PANDAWINGS_LEFT || PANDAWINGS_RIGHT

  config ZMK_SPLIT
    default y

endif
```

## boards/shields/pandawings/Kconfig.shield
```kconfig
config PANDAWINGS_V1_LEFT
  def_bool $(shields_list_contains,pandawings_v1_left)

config PANDAWINGS_V1_RIGHT
  def_bool $(shields_list_contains,pandawings_v1_right)
```

## boards/shields/pandawings_v1/Kconfig.defconfig
```kconfig
if PANDAWINGS_V1_LEFT

  config ZMK_KEYBOARD_NAME
    default "PandaWings"

  config ZMK_SPLIT_ROLE_CENTRAL
    default y

endif

if PANDAWINGS_V1_LEFT || PANDAWINGS_V1_RIGHT

  config ZMK_SPLIT
    default y

endif
```

## boards/shields/pandawingsv1/Kconfig.shield
```kconfig
config PANDAWINGSV1_LEFT
  def_bool $(shields_list_contains,pandawingsv1_left)

config PANDAWINGSV1_RIGHT
  def_bool $(shields_list_contains,pandawingsv1_right)
```

## config/boards/shields/pandawings-i/Kconfig.defconfig
```kconfig
# Copyright (c) 2022 The ZMK Contributors
# SPDX-License-Identifier: MIT

if SHIELD_PANDAWINGS-I_LEFT

config ZMK_KEYBOARD_NAME
    default "PandaWings I"

config ZMK_SPLIT_ROLE_CENTRAL
    default y

endif

if SHIELD_PANDAWINGS-I_DONGLE || SHIELD_PANDAWINGS-I_LEFT || SHIELD_PANDAWINGS-I_RIGHT

config ZMK_SPLIT
    default y

endif
```

## config/boards/shields/pandawings-i/Kconfig.shield
```kconfig
# Copyright (c) 2020 Pete Johanson
# SPDX-License-Identifier: MIT

config SHIELD_PANDAWINGS-I_LEFT
    def_bool $(shields_list_contains,pandawings-i_left)

config SHIELD_PANDAWINGS-I_RIGHT
    def_bool $(shields_list_contains,pandawings-i_right)

config SHIELD_PANDAWINGS-I_DONGLE
    def_bool $(shields_list_contains,pandawings-i_dongle)
```

## config/boards/shields/pandawingsv1/Kconfig.defconfig
```kconfig
# Copyright (c) 2020 The ZMK Contributors
# SPDX-License-Identifier: MIT

if PANDAWINGSV1_DONGLE

config ZMK_KEYBOARD_NAME
    default "PandaWings Dongle"
	
config ZMK_SPLIT_BLE_ROLE_CENTRAL
	default y
	
config ZMK_USB
	default y

endif

if PANDAWINGSV1_LEFT || PANDAWINGSV1_RIGHT || PANDAWINGSV1_DONGLE 

config ZMK_SPLIT
	default y

config ZMK_BLE
	default y
	
endif
```

## config/boards/shields/pandawingsv1/Kconfig.shield
```kconfig
config PANDAWINGSV1_LEFT
  def_bool $(shields_list_contains,pandawingsv1_left)

config PANDAWINGSV1_RIGHT
  def_bool $(shields_list_contains,pandawingsv1_right)

config PANDAWINGSV1_DONGLE
	def_bool $(shields_list_contains,pandawingsv1_dongle)
```
